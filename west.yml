## west.yml
```yaml
manifest:
  projects:
    - name: zephyr
      url: https://github.com/zephyrproject-rtos/zephyr
      revision: v4.2.2
      import:
        name-allowlist:
          - cmsis_6
          - hal_nordic
          - open-amp
          - libmetal
```
